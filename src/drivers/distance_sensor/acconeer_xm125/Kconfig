## src/drivers/distance_sensor/acconeer_xm125/Kconfig
```kconfig
menuconfig DRIVERS_DISTANCE_SENSOR_ACCONEER_XM125
	bool "acconeer_xm125"
	default n
	---help---
		Enable support for the Acconeer XM125 60 GHz pulsed coherent radar
		(A121) running the I2C Distance Detector application, used as a
		downward-facing radar altimeter.
```

## src/drivers/encoder/as5600/Kconfig
```kconfig
menuconfig DRIVERS_ENCODER_AS5600
	bool "as5600"
	default n
	---help---
		Enable support for the AMS AS5600 12-bit magnetic rotary encoder (I2C).
```

## src/drivers/power_monitor/ina226_charger/Kconfig
```kconfig
menuconfig DRIVERS_POWER_MONITOR_INA226_CHARGER
	bool "ina226_charger"
	default n
	---help---
		Enable support for the INA226 battery charging monitor (publishes battery_charging)
```

## src/drivers/power_monitor/ina228_charger/Kconfig
```kconfig
menuconfig DRIVERS_POWER_MONITOR_INA228_CHARGER
	bool "ina228_charger"
	default n
	---help---
		Enable support for the INA228 battery charging monitor (publishes battery_charging)
```

## src/drivers/runcam/Kconfig
```kconfig
menuconfig DRIVERS_RUNCAM
	bool "runcam"
	default n
	---help---
		Enable support for RunCam Device Protocol cameras (Split 4, Hybrid, Thumb Pro, ...)
```

## src/modules/self_right/Kconfig
```kconfig
menuconfig MODULES_SELF_RIGHT
	bool "self_right"
	default n
	depends on MODULES_SUN_TRACKER
	---help---
		Enable the autonomous self-righting controller. Recovers a tilt-wing aircraft from an
		inverted, at-rest float to upright using propeller thrust only: rotates the wing so the
		props point up, drives the airframe past its over-center tipping point, then cuts throttle,
		parks the wing and disarms. Exposes the SELF_RIGHT flight mode (gated on inverted + at rest).
```

## src/modules/simulation/wing_tilt_sim/Kconfig
```kconfig
menuconfig MODULES_SIMULATION_WING_TILT_SIM
	bool "wing_tilt_sim"
	default n
	---help---
		SITL-only plant model that integrates the sun_tracker tilt command into a wing angle
		and publishes sensor_encoder, to close the position loop in simulation.
```

## src/modules/sun_tracker/Kconfig
```kconfig
menuconfig MODULES_SUN_TRACKER
	bool "sun_tracker"
	default n
	depends on MODULES_WING_TILT
	---help---
		Enable the sun-tracking tilt-wing controller. Points a tilt-actuated solar surface at
		the sun using GPS position, UTC time and vehicle attitude, publishing wing-angle
		setpoints to the wing_tilt controller (which owns the encoder loop and the tilt ESC).
```

## src/modules/wing_tilt/Kconfig
```kconfig
menuconfig MODULES_WING_TILT
	bool "wing_tilt"
	default n
	---help---
		Enable the wing tilt controller — the single owner of the tilt motor. Closes a position
		loop between the AS5600 wing encoder and the reversible tilt ESC, arbitrating wing-angle
		setpoints published by client modules (sun_tracker, self_right, console holds).
```
